## glove_firmware/p4_base_station/p4_firmware/main/Kconfig.projbuild
```kconfig
menu "EchoGlove P4 Base Station"

    config P4_INTERNAL_MOCK
        bool "Enable internal mock data source (bypass UART/C6)"
        default n
        help
            Generate synthetic L/R GlovePackets at 50Hz and feed them to
            FramePairer directly, bypassing the UART receiver and the C6
            co-processor. Used for standalone P4 hardware verification
            (LVGL display + USB CDC JSON + TTS audio) without real gloves
            or a C6 ESP-NOW relay.

            Mirrors c6_firmware CONFIG_MOCK_ESP_NOW.

            Set =n for production builds that receive real data over UART
            from the C6.

endmenu
```
